## src/Kconfig.projbuild
```kconfig
menu "EyePic Config"
    menu "Network"
        menu "MQTT"
            config EP_NET_MQTT_URL
                string "Broker URL"
                default "mqtt://mqtt.eclipseprojects.io"
                help
                    URL of the broker to connect to

            config EP_NET_MQTT_TOPIC
                string "Parent Topic"
                default "eyepic"
                help
                    The name of parent topic

            config EP_NET_MQTT_AUTH
                bool "Require Authentication"
                default n

            config EP_NET_MQTT_USER
                depends on EP_NET_MQTT_AUTH
                string "MQTT Username"
                default "user"
                help
                    The username to authenticate on MQTT server to

            config EP_NET_MQTT_PASS
                depends on EP_NET_MQTT_AUTH
                string "MQTT Password"
                default "password"
                help
                    The password to authenticate on MQTT server to
        endmenu # MQTT

        menu "WiFi options"
            config EP_NET_WIFI_SSID
                string "WiFi SSID"
                default "myssid"
                help
                    SSID (network name) to connect to.

            config EP_NET_WIFI_PASSWORD
                string "WiFi Password"
                default "mypassword"
                help
                    WiFi password (WPA or WPA2) to use.

            config EP_NET_MAXIMUM_RETRY
                int "Maximum retry"
                default 5
                help
                    Set the Maximum retry to avoid station reconnecting to the AP unlimited when the AP is really inexistent.
        endmenu # WiFi options
    endmenu # General

    menu "Video camera options"
        config EP_CAM_XCLK_FREQ_HZ
            int "Frequency of XCLK signal"
            default 15000000
            help
                Frequency of XCLK signal, in Hz. EXPERIMENTAL: Set to 16MHz on ESP32-S2 or ESP32-S3 to enable EDMA mode

        choice EP_CAM_LEDC_TIMER
            prompt "LEDC timer"
            default EP_CAM_LEDC_TIMER_0
            help
                LEDC timer to be used for generating XCLK
            config EP_CAM_LEDC_TIMER_0
                bool "LEDC_TIMER_0"
            config EP_CAM_LEDC_TIMER_1
                bool "LEDC_TIMER_1"
            config EP_CAM_LEDC_TIMER_2
                bool "LEDC_TIMER_2"
            config EP_CAM_LEDC_TIMER_3
                bool "LEDC_TIMER_3"
        endchoice

        choice EP_CAM_LEDC_CHANNEL
            prompt "LEDC channel"
            default EP_CAM_LEDC_CHANNEL_0
            help
                LEDC channel to be used for generating XCLK
            config EP_CAM_LEDC_CHANNEL_0
                bool "LEDC_CHANNEL_0"
            config EP_CAM_LEDC_CHANNEL_1
                bool "LEDC_CHANNEL_1"
            config EP_CAM_LEDC_CHANNEL_2
                bool "LEDC_CHANNEL_2"
            config EP_CAM_LEDC_CHANNEL_3
                bool "LEDC_CHANNEL_3"
            config EP_CAM_LEDC_CHANNEL_4
                bool "LEDC_CHANNEL_4"
            config EP_CAM_LEDC_CHANNEL_5
                bool "LEDC_CHANNEL_5"
        endchoice

        choice EP_CAM_MODULE
            bool "Select Camera Pinout"
            default EP_CAM_MODULE_AI_THINKER
            help
                Select Camera Pinout.
             config EP_CAM_MODULE_WROVER_KIT
                 bool "WROVER-KIT With OV2640 Module"
             config EP_CAM_MODULE_ESP_EYE
                 bool "ESP-EYE DevKit"
             config EP_CAM_MODULE_ESP_S2_KALUGA
                 bool "ESP32-S2-Kaluga-1 V1.3"
             config EP_CAM_MODULE_ESP_S3_EYE
                 bool "ESP-S3-EYE DevKit"
             config EP_CAM_MODULE_ESP32_CAM_BOARD
                 bool "ESP32 Camera Development Board"
             config EP_CAM_MODULE_M5STACK_PSRAM
                 bool "M5Stack Camera With PSRAM"
             config EP_CAM_MODULE_M5STACK_WIDE
                 bool "M5Stack Camera F (Wide)"
             config EP_CAM_MODULE_AI_THINKER
                 bool "ESP32-CAM by AI-Thinker"
             config EP_CAM_MODULE_CUSTOM
                 bool "Custom Camera Pinout"
        endchoice

        menu "Pins config"
        depends on EP_CAM_MODULE_CUSTOM
            config EP_CAM_PIN_PWDN
                int "Pin PWDN value"
                default 32
                help
                    The pin number for the power-down pin of the camera.
            config EP_CAM_PIN_RESET
                int "Pin RESET value"
                default -1
                help
                    The pin number for the reset pin of the camera.
            config EP_CAM_PIN_XCLK
                int "Pin XCLK value"
                default 0
                help
                    The pin number for the clock pin of the camera.
            config EP_CAM_PIN_SIOD
                int "Pin SIOD value"
                default 26
                help
                    The pin numbers for the SCCB (I2C-like) data and clock pins of the camera.
            config EP_CAM_PIN_SIOC
                int "Pin SIOC value"
                default 27
                help
                    The pin numbers for the SCCB (I2C-like) data and clock pins of the camera.
            config EP_CAM_PIN_D7
                int "Pin D7 value"
                default 35
                help
                    The pin numbers for the data pin D7 of the camera.
            config EP_CAM_PIN_D6
                int "Pin D6 value"
                default 34
                help
                    The pin numbers for the data pin D6 of the camera.
            config EP_CAM_PIN_D5
                int "Pin D5 value"
                default 39
                help
                    The pin numbers for the data pin D5 of the camera.
            config EP_CAM_PIN_D4
                int "Pin D4 value"
                default 36
                help
                    The pin numbers for the data pin D4 of the camera.
            config EP_CAM_PIN_D3
                int "Pin D3 value"
                default 21
                help
                    The pin numbers for the data pin D3 of the camera.
            config EP_CAM_PIN_D2
                int "Pin D2 value"
                default 19
                help
                    The pin numbers for the data pin D2 of the camera.
            config EP_CAM_PIN_D1
                int "Pin D1 value"
                default 18
                help
                    The pin numbers for the data pin D1 of the camera.
            config EP_CAM_PIN_D0
                int "Pin D0 value"
                default 5
                help
                    The pin numbers for the data pin D0 of the camera.
            config EP_CAM_PIN_VSYNC
                int "Pin VSYNC value"
                default 25
                help
                    The pin numbers for the vertical sync pin of the camera.
            config EP_CAM_PIN_HREF
                int "Pin HREF value"
                default 23
                help
                    The pin numbers for the horizontal reference pin of the camera.
            config EP_CAM_PIN_PCLK
                int "Pin PCLK value"
                default 22
                help
                    The pin numbers for the pixel clock pin of the camera.
        endmenu # Pin config
    endmenu # Video camera menu
endmenu
```
